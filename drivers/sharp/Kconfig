## drivers/sharp/Kconfig
```kconfig
#
# SHARP configuration
#

menu "SHARP Device Drivers"

#source "drivers/sharp/shdiag/Kconfig"
source "drivers/sharp/shdisp/Kconfig"
#source "drivers/sharp/shbatt/Kconfig"
#source "drivers/sharp/mfc/Kconfig"
#source "drivers/sharp/nfc/Kconfig"
#source "drivers/sharp/shmds/Kconfig"
source "drivers/sharp/shsensor_hub/ml630q790/Kconfig"

#CONFIG_SH_AUDIO_DRIVER-> 06-007
source "drivers/sharp/shaudio/Kconfig"
#CONFIG_SH_AUDIO_DRIVER<- 06-007

#source "drivers/sharp/tunerdrv/Kconfig"
#source "drivers/sharp/tunerdrv_tmm/Kconfig"
#source "drivers/sharp/shtimer/Kconfig"
source "drivers/sharp/proximity/Kconfig"
#source "drivers/sharp/proximity_cdc/Kconfig"
#source "drivers/sharp/shgrip/Kconfig"
#source "drivers/sharp/shterm/Kconfig"
#source "drivers/sharp/shlog/Kconfig"
#source "drivers/sharp/wifi/Kconfig"
source "drivers/sharp/shtps/Kconfig"
#source "drivers/sharp/shirda/Kconfig"
source "drivers/sharp/shcamled/Kconfig"
source "drivers/sharp/shvibrator/Kconfig"
#source "drivers/sharp/vold/Kconfig"

endmenu
```

## drivers/sharp/shsensor_hub/ml630q790/Kconfig
```kconfig
#
# SensorHub drivers configuration
#

menuconfig SHUB
	bool "SensorHub Support"
	depends on INPUT && (I2C||SPI)
	default y
	---help---
	  Say Y here to get to see options for sensor hub interface.

config SHUB_ML630Q790
	bool "LAPIS Semicomductor ML610Q793 SensorHub Micom"
	depends on SHUB
	default y
	help
	 --- help ---
	 If you say yes here you get support for SHUB_ML630Q790.

config HOSTIF_SPI
	bool "HostI/F use the SPI"
	depends on SHUB_ML630Q790
	default y
	help
	 --- help ---
	 Not tested.

config HOSTIF_I2C
	bool "HostI/F use the I2C"
	depends on SHUB_ML630Q790
	default n
	help
	 --- help ---
	 Please not set at the same time as SPI.

config ML630Q790_DEBUG
	bool "Output debug message"
	depends on SHUB_ML630Q790
	default n
	help
	 --- help ---
	 If you say yes here you output debug message.

config ACC_SENSOR
	bool "Support accelometer"
	depends on SHUB_ML630Q790
	default y
	help
	 --- help ---
	 If you say yes here you get support for accelometer.

config GYRO_SENSOR
	bool "Support gyroscope"
	depends on SHUB_ML630Q790
	default y
	help
	 --- help ---
	 If you say yes here you get support for gyroscope.

config MAG_SENSOR
	bool "Support magnetic filed sensor"
	depends on SHUB_ML630Q790
	default y
	help
	 --- help ---
	 If you say yes here you get support for magnetic filed sensor.

config ALS_SENSOR
	bool "Support ambient light sensor"
	depends on SHUB_ML630Q790
	default n
	help
	 --- help ---
	 If you say yes here you get support for ambient light sensor.

config PS_SENSOR
	bool "Support proximity sensor"
	depends on SHUB_ML630Q790
	default n
	help
	 --- help ---
	 If you say yes here you get support for proximity sensor.

config ELECTRODE
	bool "Support Electrode"
	depends on SHUB_ML630Q790
	default n
	help
	 --- help ---
	 If you say yes here you get support for Electrode Detection.

config ORI_SENSOR
	bool "Support orientation sensor"
	depends on SHUB_ML630Q790
	default y
	help
	 --- help ---
	 If you say yes here you get support for orientation sensor.

config LINEACC_SENSOR
	bool "Support liner acc sensor"
	depends on SHUB_ML630Q790
	default y
	help
	 --- help ---
	 If you say yes here you get support for liner acc sensor.

config GAMEROT_SENSOR
	bool "Support Game rotation sensor"
	depends on SHUB_ML630Q790
	default y
	help
	 --- help ---
	 If you say yes here you get support for Game rotation sensor.

config GRAV_SENSOR
	bool "Support gravity sensor"
	depends on SHUB_ML630Q790
	default y
	help
	 --- help ---
	 If you say yes here you get support for gravity sensor.

config GYROUNC_SENSOR
	bool "Support Gyro uncalibration sensor"
	depends on SHUB_ML630Q790
	default y
	help
	 --- help ---
	 If you say yes here you get support for Gyro uncalibration sensor.

config MAGROT_SENSOR
	bool "Support Mag rotation sensor"
	depends on SHUB_ML630Q790
	default y
	help
	 --- help ---
	 If you say yes here you get support for Mag rotation sensor.

config MAGUNC_SENSOR
	bool "Support Mag uncalibration sensor"
	depends on SHUB_ML630Q790
	default y
	help
	 --- help ---
	 If you say yes here you get support for Mag uncalibration sensor.

config ROTVEC_SENSOR
	bool "Support Rotation vec sensor"
	depends on SHUB_ML630Q790
	default y
	help
	 --- help ---
	 If you say yes here you get support for Rotation vec sensor.

config PEDO_SENSOR
	bool "Support Pedo sensor"
	depends on SHUB_ML630Q790
	default y
	help
	 --- help ---
	 If you say yes here you get support for Pedo sensor.

config PEDODEC_SENSOR
	bool "Support Pedo dect sensor"
	depends on SHUB_ML630Q790
	default y
	help
	 --- help ---
	 If you say yes here you get support for Pedo dect sensor.

config SIGNIFICANT_MOTION
	bool "Support Significant motion"
	depends on SHUB_ML630Q790
	default y
	help
	 --- help ---
	 If you say yes here you get support for Significant motion.
```

## drivers/sharp/shtps/atmel/Kconfig
```kconfig
#
# Sharp Touchscreen configuration
#

if TOUCHSCREEN_SHTPS

	config SHTPS_MXT_DEV
		tristate "Atmel Device"
		default n
		depends on TOUCHSCREEN_SHTPS

	config SHTPS_ATMEL_MXT336T
		tristate "Atmel mXT336T"
		default n
		depends on SHTPS_MXT_DEV

endif # TOUCHSCREEN_SHTPS
```

## drivers/sharp/shtps/sy3000/Kconfig
```kconfig
#
# Sharp Touchscreen configuration
#

if TOUCHSCREEN_SHTPS

	config SHTPS_SY3X00_DEV
		tristate "SY3x00 Device"
		default n
		depends on TOUCHSCREEN_SHTPS

	config SHTPS_SY3000_TM3058_001
		tristate "SY3000 TM3058-001"
		default n
		depends on SHTPS_SY3X00_DEV

	config SHTPS_SY3000_TM3059_001
		tristate "SY3000 TM3059-001"
		default n
		depends on SHTPS_SY3X00_DEV

endif # TOUCHSCREEN_SHTPS
```

## drivers/sharp/shvibrator/Kconfig
```kconfig
#
# Sharp Linear Vibrator Driver configuration
#

menu "SHVIBRATOR driver"

comment "SHARP Linear Vibrator drivers"

config SHVIBRATOR_LINEAR
	bool "SHARP Linear Vibrator"
	default n

endmenu
```
